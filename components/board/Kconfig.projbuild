## components/board/Kconfig.projbuild
```kconfig
menu "BSP / Board"

config ARS_LCD_PCLK_HZ
    int "Fréquence pixel clock (Hz)"
    default 51200000
    help
        Fréquence du pclk pour le panneau RGB 1024x600. Valeur recommandée
        pour 60 Hz avec timings 1344x635 : ~51.2 MHz. Ajustable pour A/B test.

config ARS_LCD_PCLK_ACTIVE_NEG
    bool "PCLK actif sur front descendant"
    default y
    help
        Active l'horloge pixel sur front descendant (recommandé ST7262). Permet
        d'inverser pour diagnostic.

config ARS_LCD_HSYNC_IDLE_LOW
    bool "HSYNC idle bas"
    default n
    help
        Niveau idle pour HSYNC. Off = idle haut (comportement actuel).

config ARS_LCD_VSYNC_IDLE_LOW
    bool "VSYNC idle bas"
    default n
    help
        Niveau idle pour VSYNC. Off = idle haut (comportement actuel).

config ARS_LCD_DE_IDLE_HIGH
    bool "DE idle haut"
    default n
    help
        Niveau idle pour DE. Off = idle bas (comportement actuel).

config ARS_BACKLIGHT_USE_IO_EXPANDER
    bool "Piloter le rétroéclairage via l'IO expander"
    default y
    help
        Utiliser l'IO expander CH32V003 (Waveshare) pour activer le
        rétroéclairage (IO_2). Désactiver pour forcer l'usage d'un GPIO direct.

config ARS_BACKLIGHT_GPIO
    int "GPIO de secours pour le rétroéclairage (LEDC)"
    default -1
    range -1 48
    help
        GPIO optionnel pour piloter le rétroéclairage via LEDC. Laisser -1 si
        aucun GPIO direct n'est câblé.

config ARS_BAT_ADC_UNIT
    int "ADC unit pour la batterie"
    default 1
    range 1 2

config ARS_BAT_ADC_CHANNEL
    int "Canal ADC pour la batterie"
    default 7
    range 0 9

config ARS_BAT_DIV_NUM
    int "Diviseur de tension - numérateur"
    default 2

config ARS_BAT_DIV_DEN
    int "Diviseur de tension - dénominateur"
    default 1
    help
        Rapport du pont diviseur utilisé en entrée de l'ADC (num/den).

config ARS_SKIP_TEST_PATTERN
    bool "Ignorer le motif de test LCD au boot"
    default n
    help
        Désactive l'affichage systématique du motif de test (barres RGBWB)
        pour éviter une allocation PSRAM importante et accélérer le démarrage.

config ARS_LCD_BOOT_TEST_PATTERN
    bool "Afficher le motif de test LCD au boot (~2s)"
    default n
    help
        Force l'affichage d'un motif de test (barres RGBWB) pendant environ
        2 secondes au démarrage, même si LVGL n'est pas initialisé. Ignoré si
        ARS_SKIP_TEST_PATTERN est actif.

config ARS_LCD_BOOT_TEST_PATTERN_MS
    int "Durée du motif de test (ms)"
    depends on ARS_LCD_BOOT_TEST_PATTERN
    range 200 5000
    default 2000
    help
        Durée indicative pendant laquelle le motif de test reste affiché avant
        de poursuivre le flux normal. Exécuté dans une tâche dédiée pour ne pas
        bloquer le boot.

choice ARS_DISPLAY_ROTATION
    prompt "Rotation de l'affichage (LVGL)"
    default ARS_DISPLAY_ROTATION_180

    config ARS_DISPLAY_ROTATION_0
        bool "0° (origine en haut/gauche)"
    config ARS_DISPLAY_ROTATION_90
        bool "90°"
    config ARS_DISPLAY_ROTATION_180
        bool "180°"
    config ARS_DISPLAY_ROTATION_270
        bool "270°"
endchoice

endmenu
```

## components/data_manager/Kconfig.projbuild
```kconfig
menu "Data Manager"

config ARS_DATA_MAX_JSON_SIZE
    int "Taille max des fichiers JSON (octets)"
    default 8192
    help
        Limite de sécurité pour la taille des fichiers JSON lus depuis LittleFS.
        Les fichiers plus volumineux sont rejetés pour éviter les OOM.

endmenu
```

## components/io_extension/Kconfig
```kconfig
menu "IO Extension (CH32V003)"

config ARS_IOEXT_SCL_SPEED_HZ
    int "Fréquence I2C pour l'IO extender"
    default 100000
    range 10000 400000
    help
      Vitesse d'horloge I2C appliquée au CH32V003 (addr 0x24) via le bus
      partagé (SDA=GPIO8, SCL=GPIO9). Utilisée aussi pour les rafales CS SD
      (ExtCS). 100 kHz recommandé pour la stabilité ; augmenter seulement si
      validé sur la carte.

endmenu
```

## components/iot/Kconfig
```kconfig
menu "IoT Configuration"
    config IOT_WIFI_ENABLED
        bool "Enable Wi-Fi and MQTT"
        default n
        help
            Enable Wi-Fi connectivity and MQTT client.

    config IOT_WIFI_SSID
        string "Wi-Fi SSID"
        default "myssid"
        depends on IOT_WIFI_ENABLED
        help
            SSID of the Wi-Fi network to connect to.

    config IOT_WIFI_PASSWORD
        string "Wi-Fi Password"
        default "mypassword"
        depends on IOT_WIFI_ENABLED
        help
            Password of the Wi-Fi network.
endmenu
```

## components/lvgl_port/Kconfig
```kconfig
menu "LVGL Port Configuration"

    config ARS_LVGL_TASK_CORE
        int "LVGL Task Core ID"
        default 1
        range 0 1
        help
            Core where the LVGL task is pinned.

    config ARS_LVGL_TASK_PRIO
        int "LVGL Task Priority"
        default 10
        help
            Priority of the LVGL task.

    config ARS_LVGL_TASK_STACK
        int "LVGL Task Stack Size"
        default 8192
        help
            Stack size in bytes for the LVGL task.

    config ARS_LVGL_MAX_SLEEP_MS
        int "Max Sleep Duration (ms)"
        default 20
        help
            Maximum time to sleep in lv_timer_handler loop. 
            Prevents blocking IDLE task for too long.

    config ARS_LVGL_TASK_MIN_SLEEP_MS
        int "Min Sleep Duration (ms)"
        default 10
        help
            Minimum time to sleep to ensure IDLE task runs (prevents WDT).

    config ARS_LVGL_REFRESH_HZ
        int "Max Refresh Rate (Hz)"
        default 30
        help
            Limit the refresh rate to save CPU.

    config ARS_LVGL_COLOR_DEPTH
        int "Color Depth (bits)"
        default 16
        help
            Color depth 16 (RGB565) or 32 (ARGB8888).

    config ARS_LVGL_USE_DOUBLE_BUF
        bool "Use Double Buffering"
        default n
        help
            Use double buffering for smooth rendering (requires more RAM/PSRAM).

    config ARS_LVGL_BUF_LINES
        int "Buffer Size (Lines)"
        default 80
        help
            Number of lines per buffer.
            Buffer size = H_RES * LINES * (DEPTH/8).
            Example: 1024 * 60 * 2 = ~120KB.

    config ARS_LCD_VSYNC_WAIT_ENABLE
        bool "Enable RGB VSYNC wait integration"
        default y
        help
            Master switch for VSYNC wait logic. Keep disabled by default to
            avoid stalls when callbacks are unsupported; enable only after
            validating RGB driver support.

    config ARS_LCD_WAIT_VSYNC
        bool "Wait for RGB VSYNC before releasing LVGL flush"
        depends on ARS_LCD_VSYNC_WAIT_ENABLE
        default y
        help
            When enabled, the LVGL flush waits for the next RGB VSYNC event
            (via driver callback) with a bounded timeout. Disable if the panel
            or SDK does not support RGB VSYNC callbacks.

    config ARS_LCD_WAIT_VSYNC_TIMEOUT_MS
        int "VSYNC wait timeout (ms)"
        depends on ARS_LCD_WAIT_VSYNC
        default 20
        range 5 100
        help
            Maximum time to wait for an RGB VSYNC notification before
            disabling VSYNC wait to avoid stalls.

    config ARS_LVGL_DEBUG_SCREEN
        bool "Enable Debug Screen"
        default n
        help
            If enabled, shows a simple LVGL debug screen instead of the main UI.

    config ARS_UI_HEARTBEAT
        bool "Afficher un heartbeat LVGL minimal"
        default n
        help
            Ajoute un compteur discret (coin écran) qui s'incrémente chaque
            seconde pour valider le mode DIRECT.

endmenu
```

## components/net/Kconfig
```kconfig
menu "Network Manager"

config ARS_WIFI_USE_NVS
    bool "Use NVS for WiFi credentials"
    default y
    help
        If enabled, try to load WiFi credentials from NVS (namespace "net") first.

config ARS_WIFI_SSID
    string "Default WiFi SSID"
    default ""
    help
        Optional Wi-Fi SSID used when no credentials are provisioned in NVS.

config ARS_WIFI_PASSWORD
    string "Default WiFi password"
    default ""
    help
        Optional Wi-Fi password used when no credentials are provisioned in NVS.

    config ARS_WIFI_AUTOCONNECT
        bool "Auto Connect on Boot"
        default y
        help
            Automatically try to connect to the configured Wi-Fi network on boot.

config ARS_ENABLE_HTTP_CLIENT
    bool "Activer le client HTTP/HTTPS utilitaire"
    default n
    help
        Active les appels net_http_get (prévu pour HTTPS uniquement). Laisser
        désactivé en production si non utilisé.

config ARS_HTTP_CLIENT_ALLOW_INSECURE
    bool "Autoriser les URLs HTTP non sécurisées"
    depends on ARS_ENABLE_HTTP_CLIENT
    default n
    help
        Si désactivé, seules les URLs https:// seront acceptées par net_http_get.

endmenu
```

## components/rgb_lcd_port/Kconfig.projbuild
```kconfig
menu "RGB LCD Guard"

    config ARS_LCD_PCLK_GUARD_ENABLE
        bool "Activer la baisse temporaire du PCLK pendant les opérations sensibles"
        default n
        help
            Ajoute un garde facultatif autour des phases Wi‑Fi/flash/NVS qui
            réduit le pixel clock via esp_lcd_rgb_panel_set_pclk(), attend une
            frame, puis restaure la fréquence nominale. Utile pour limiter le
            drift observé pendant les accès radio/flash (voir ESP FAQ LCD).

    config ARS_LCD_PCLK_GUARD_SAFE_HZ
        int "Fréquence PCLK réduite (Hz)"
        depends on ARS_LCD_PCLK_GUARD_ENABLE
        default 12000000
        range 1000000 40000000
        help
            Fréquence PCLK appliquée durant le garde. Doit rester compatible
            avec les timings du panneau (valeur recommandée: ~12 MHz pour 1024x600).

    config ARS_LCD_PCLK_GUARD_SETTLE_MS
        int "Temps de stabilisation PCLK (ms)"
        depends on ARS_LCD_PCLK_GUARD_ENABLE
        default 50
        range 1 200
        help
            Délai minimal (en ms) laissé après chaque changement de fréquence
            avant de poursuivre l'opération critique (≈1 frame à ~20–30 Hz).

endmenu
```
