## components/sd/Kconfig
```kconfig
menu "SD Card Configuration"

    choice ARS_SD_CS_MODE
        prompt "SD SPI CS Mode"
        default ARS_SD_CS_MODE_IO_EXPANDER
        help
            Select the Chip Select (CS) mode for the SD Card.
            - GPIO: Native ESP32 GPIO control.
            - IO_EXPANDER: Controlled via CH32V003 IO Expander (Waveshare).

        config ARS_SD_CS_MODE_GPIO
            bool "Native GPIO"
        
        config ARS_SD_CS_MODE_IO_EXPANDER
            bool "IO Expander (CH32V003, Waveshare)"
    endchoice

    config ARS_SD_CS_GPIO
        int "SD CS GPIO Pin"
        depends on ARS_SD_CS_MODE_GPIO
        default -1
        help
            GPIO pin for SD Card CS when using Native GPIO mode.

    config ARS_SD_CS_EXIO
        int "SD CS IO Expander Pin (EXIO)"
        depends on ARS_SD_CS_MODE_IO_EXPANDER
        default 4
        help
            EXIO pin index on CH32V003 IO expander (0-7). Waveshare 7B uses
            EXIO4.

    config ARS_SD_MOSI
        int "SD SPI MOSI GPIO"
        default 11

    config ARS_SD_MISO
        int "SD SPI MISO GPIO"
        default 13

    config ARS_SD_SCK
        int "SD SPI SCK GPIO"
        default 12

    config ARS_SD_EXTCS_INIT_FREQ_KHZ
        int "SDSPI init frequency (kHz)"
        default 100
        range 100 1000
        help
            SPI clock during CMD0/CMD8/ACMD41 when using external CS.
            Use conservative values (100-400kHz) for noisy boards or slow CS paths.

    config ARS_SD_EXTCS_CMD0_PRE_CLKS_BYTES
        int "Dummy bytes before CMD0 (ExtCS)"
        default 20
        range 10 64
        help
            Number of 0xFF bytes clocked with CS high before issuing CMD0 in
            external CS mode. Increase for cards that need >80 clocks before
            entering SPI mode.

    config ARS_SD_EXTCS_CS_PRE_CMD0_DELAY_US
        int "CS settle delay before first CMD0 (ExtCS, us)"
        default 180
        range 0 1000
        help
            Extra settling delay (microseconds) applied immediately after
            driving CS low during the CMD0 pre-sequence. Use this to let the
            IO extender output stabilize before the first transaction if MISO
            occasionally reads stuck-high.

    config ARS_SD_EXTCS_CS_I2C_SETTLE_US
        int "Post-CS I2C pacing delay (us)"
        default 200
        range 0 500
        help
            Microsecond delay after IO extender CS writes to allow CH32V003
            outputs to settle before SPI activity. Use 100–300us for noisy
            boards; set 0 to disable.

    config ARS_SD_EXTCS_TARGET_FREQ_KHZ
        int "SDSPI target frequency after init (kHz)"
        default 20000
        range 1000 40000
        help
            Target SPI clock after OCR is stable. Driver will clamp to card max.

    config ARS_SD_EXTCS_TIMING_LOG
        bool "Enable ExtCS SDSPI timing log"
        default n
        help
            Print detailed timing for every SDSPI transaction and current
            clock setting while using the External CS path. Disable for
            production to reduce log noise.

    config ARS_SD_EXTCS_DEBUG_CMD0
        bool "Verbose CMD0 debug dump"
        default n
        help
            Log raw response windows and per-try diagnostics for CMD0 entry
            (external CS mode). Enable only during hardware bring-up.

    config ARS_SD_EXTCS_MISO_HEALTH_CHECK
        bool "Enable MISO health diagnostics around CMD0"
        default n
        help
            When enabled, sample MISO with CS high/low before CMD0 to detect
            stuck CS lines or floating MISO. Logs warnings but does not block
            init.

    config ARS_SD_EXTCS_MISO_STUCK_DEBUG
        bool "Force-CS MISO debug sampler"
        default n
        help
            When enabled, run an extra diagnostic before CMD0 that forces CS
            low via the IO extender, clocks the bus, and samples MISO/GPIO
            multiple times to detect lines stuck high. The check is non-blocking
            and only logs the observed pattern.

    config ARS_SD_EXTCS_MISO_STUCK_SAMPLE_BYTES
        int "Bytes to clock during MISO stuck debug"
        depends on ARS_SD_EXTCS_MISO_STUCK_DEBUG
        default 8
        range 1 32
        help
            Number of 0xFF bytes clocked while CS is forced low in the MISO
            stuck debug sampler.

    config ARS_SD_EXTCS_CS_READBACK
        bool "Read back IO extender latch after CS writes"
        default n
        help
            When enabled, the driver re-reads the IO extender output latch
            after asserting/deasserting CS to confirm the level. Adds a small
            I2C transaction per CS toggle; keep disabled in production unless
            debugging CS reliability.

    config ARS_IOEXT_READBACK_DIAG
        bool "Run one-time IO extender readback diagnostic at SD probe"
        default n
        help
            Perform a single readback of the IO extender output latch during SD
            ExtCS probing to confirm wiring. Not used during normal CS toggles
            to avoid I2C contention.

    config ARS_SD_PAUSE_TOUCH_DURING_SD_INIT
        bool "Pause GT911 touch polling during SD init (ExtCS debug aid)"
        default y
        help
            When enabled, the GT911 touch task is temporarily paused around the
            SD init/mount sequence to eliminate I2C contention while toggling
            the IO expander for SD CS. Use for diagnostics; disable for normal
            operation.

    config ARS_SD_DIAG_VERBOSE
        bool "Verbose SD ExtCS diagnostics"
        default n
        help
            Emit extra debug logs for SD ExtCS CS toggling and retries. Keep
            disabled in production to avoid log spam.

    config ARS_SD_EXTCS_STAGE_LOG
        bool "Log one line per SD ExtCS init stage"
        default y
        help
            Emit compact logs for CMD0, CMD8, ACMD41 and CMD58 (once per
            stage) plus recovery events. Keeps visibility during bring-up
            without flooding output.

    config ARS_SD_SDMMC_DEBUG_LOG
        bool "Enable SDMMC/SDSPI debug logs"
        default n
        help
            Raise log level for sdmmc/sdspi components to DEBUG for deeper
            diagnostics during bring-up. Disable in production.

endmenu
```

## components/touch/Kconfig
```kconfig
menu "Touch Configuration"

    config ARS_TOUCH_X_MAX
        int "Touch Panel Width"
        default 1024
        help
            Maximum X coordinate resolution of the touch panel.

    config ARS_TOUCH_Y_MAX
        int "Touch Panel Height"
        default 600
        help
            Maximum Y coordinate resolution of the touch panel.

    config ARS_TOUCH_SWAP_XY
        bool "Swap X and Y Axes"
        default n
        help
            Swap the X and Y axes of the touch report.

    config ARS_TOUCH_MIRROR_X
        bool "Mirror X Axis"
        default n
        help
            Invert the X coordinate (X = Max - X).

    config ARS_TOUCH_MIRROR_Y
        bool "Mirror Y Axis"
        default n
        help
            Invert the Y coordinate (Y = Max - Y).

    config ARS_TOUCH_OFFSET_X
        int "Touch X Offset"
        default 0
        help
            Add constant offset to X coordinate.

    config ARS_TOUCH_OFFSET_Y
        int "Touch Y Offset"
        default 0
        help
            Add constant offset to Y coordinate.

    config ARS_TOUCH_SCALE_X
        int "Touch X Scale (x1000)"
        default 1000
        help
            Scale X coordinate by (Value / 1000.0). Default 1000 = 1.0x.

    config ARS_TOUCH_SCALE_Y
        int "Touch Y Scale (x1000)"
        default 1000
        help
            Scale Y coordinate by (Value / 1000.0). Default 1000 = 1.0x.

    config ARS_TOUCH_DISABLE_LEGACY_CAL
        bool "Disable legacy Kconfig scale/offset when affine transform is used"
        default y
        help
            When enabled, raw GT911 coordinates are forwarded without applying
            the legacy offset/scale parameters. This avoids double calibration
            when the affine touch_transform pipeline is active.

    config ARS_TOUCH_CLEAR_PROFILES_ON_BOOT
        bool "Clear touch orientation/calibration profiles on each boot"
        default n
        help
            When enabled, the touch orientation namespace ("touch") and
            calibration slots ("touchcal") are erased at boot before applying
            defaults. Use this to recover from inverted axes caused by stale
            NVS entries or after changing hardware orientation.

    config TOUCH_DEBUG_LOG
        bool "Enable Reduced Hardware Debug Logs"
        default n
        help
            Enable debug logging for touch input processing in LVGL port.
            Reduces spam by only logging changes or significant events.

    config GT911_DEBUG_DUMP
        bool "Dump raw GT911 frames (rate-limited)"
        default n
        help
            When enabled, the GT911 driver will periodically dump the status
            byte and raw point buffer in hexadecimal along with decoded fields
            to ease troubleshooting of touch parsing/endianness issues.

    choice ARS_TOUCH_GT911_LAYOUT
        prompt "GT911 point layout selection"
        default ARS_TOUCH_GT911_LAYOUT_AUTO
        help
            Select how the GT911 point buffer is decoded. Auto will choose the
            most plausible layout per point (preferring layout A when both are
            plausible).

        config ARS_TOUCH_GT911_LAYOUT_AUTO
            bool "Auto-select (prefer layout A)"

        config ARS_TOUCH_GT911_LAYOUT_A
            bool "Force layout A (x/y at offsets 0/2, id at 6)"

        config ARS_TOUCH_GT911_LAYOUT_B
            bool "Force layout B (legacy: id byte first, x/y at 1/3)"
    endchoice

    config ARS_TOUCH_GT911_LAYOUT_MARGIN
        int "GT911 layout plausibility margin (pixels)"
        range 0 256
        default 32
        help
            Margin applied when evaluating whether decoded coordinates are
            plausible. Larger margins tolerate noise but may hide format
            issues.

endmenu
```

## components/touch_transform/Kconfig
```kconfig
menu "Touch transform options"

config TOUCH_TRANSFORM_ENABLE_TESTS
    bool "Build touch transform unit tests"
    default n
    help
        Enable building of the touch_transform component's Unity tests.
        Leave disabled for production firmware to avoid linking the Unity
        test framework into the main application image.

endmenu
```

## components/web_server/Kconfig.projbuild
```kconfig
menu "Serveur Web A.R.S"

config ARS_WEB_ENABLE
    bool "Activer le serveur web"
    default y
    help
        Permet de désactiver entièrement l'interface HTTP en production ou sur des
        environnements sensibles.

config ARS_WEB_AUTH_TOKEN_BYTES
    int "Taille du jeton d'authentification (octets)"
    range 8 64
    default 16
    help
        Jeton secret généré aléatoirement au premier démarrage et stocké dans NVS
        (namespace "web", clef "auth_token"). Utilisé avec l'en-tête
        Authorization: Bearer <token>.

config ARS_WEB_CORS_ORIGIN
    string "Origine CORS autorisée"
    default ""
    help
        Origine autorisée pour CORS. Laisser vide pour désactiver CORS et éviter
        les accès cross-origin.

config ARS_WEB_REQUIRE_TLS_PROXY
    bool "Accès web derrière proxy TLS"
    default y
    help
        Indique que l'interface HTTP doit être placée derrière un reverse proxy
        TLS (Nginx/Traefik). Aucune session HTTPS native n'est lancée ici.

config ARS_WEB_MAX_CONTENT_LENGTH
    int "Taille maximale des requêtes (octets)"
    default 4096
    help
        Limite la taille des requêtes HTTP acceptées par les handlers JSON.

endmenu
```
